## deviceDriver/Kconfig
```kconfig
# SPDX-License-Identifier: GPL-2.0-only
config IRRECEIVER
	tristate "IR Receiver for rgb remotes"
	depends on GPIOLIB
	help
	  The driver for the IR receiver

	  If you don't know what to do here, say N.
```
